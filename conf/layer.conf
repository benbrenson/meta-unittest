## conf/layer.conf
```bitbake
# We have a conf and classes directory, add to BBPATH
BBPATH .= ":${LAYERDIR}"

# We have recipes-* directories, add to BBFILES
BBFILES +=  "${LAYERDIR}/recipes-*/*/*.bb"
BBFILES +=  " ${LAYERDIR}/recipes-*/*/*.bbappend "

BBFILE_COLLECTIONS += "unittest"
BBFILE_PATTERN_unittest = "^${LAYERDIR}/"
BBFILE_PRIORITY_unittest = "6"

# This should only be incremented on significant changes that will
# cause compatibility issues with other layers
LAYERVERSION_unittest = "1"

LAYERDIR_unittest = "${LAYERDIR}"
```
